## cansat_apps/camera_nn/Kconfig
```kconfig
config CANSAT_APPS_CAMERA_NN
	tristate "Camera neural network test with TensorFlow"
	default y
	---help---
		Enable the camera_nn app

if CANSAT_APPS_CAMERA_NN

config CANSAT_APPS_CAMERA_NN_PROGNAME
	string "Program name"
	default "camera_nn"
	---help---
		This is the name of the program that will be use when the NSH ELF
		program is installed.

config CANSAT_APPS_CAMERA_NN_PRIORITY
	int "camera_nn task priority"
	default 100

config CANSAT_APPS_CAMERA_NN_STACKSIZE
	int "camera_nn stack size"
	default 2048

endif
```

## cansat_apps/camera_test/Kconfig
```kconfig
config CANSAT_APPS_CAMERA_TEST
	tristate "Camera board test for future implementation"
	default y
	---help---
		Enable the camera_test app

if CANSAT_APPS_CAMERA_TEST

config CANSAT_APPS_CAMERA_TEST_PROGNAME
	string "Program name"
	default "camera_test"
	---help---
		This is the name of the program that will be use when the NSH ELF
		program is installed.

config CANSAT_APPS_CAMERA_TEST_PRIORITY
	int "camera_test task priority"
	default 100

config CANSAT_APPS_CAMERA_TEST_STACKSIZE
	int "camera_test stack size"
	default 2048

endif
```

## cansat_apps/flight/Kconfig
```kconfig
config CANSAT_APPS_FLIGHT
	tristate "Flight manager for sensors and LoRa transmission"
	default y
	---help---
		Enable the flight app

if CANSAT_APPS_FLIGHT

config CANSAT_APPS_FLIGHT_PROGNAME
	string "Program name"
	default "flight"
	---help---
		This is the name of the program that will be use when the NSH ELF
		program is installed.

config CANSAT_APPS_FLIGHT_PRIORITY
	int "flight task priority"
	default 100

config CANSAT_APPS_FLIGHT_STACKSIZE
	int "flight stack size"
	default 2048

endif
```

## cansat_apps/gps_test/Kconfig
```kconfig
config CANSAT_APPS_GPS_TEST
	tristate "GPS test application"
	default y
	---help---
		Enable the gps_test app

if CANSAT_APPS_GPS_TEST

config CANSAT_APPS_GPS_TEST_PROGNAME
	string "Program name"
	default "gps_test"
	---help---
		This is the name of the program that will be use when the NSH ELF
		program is installed.

config CANSAT_APPS_GPS_TEST_PRIORITY
	int "gps_test task priority"
	default 100

config CANSAT_APPS_GPS_TEST_STACKSIZE
	int "gps_test stack size"
	default 2048


choice
	prompt "Event notification"
	default CANSAT_APPS_GNSS_USE_POLL

config CANSAT_APPS_GNSS_USE_POLL
	bool "Polling notification"

config CANSAT_APPS_GNSS_USE_SIGNAL
	bool "Signal notification"

endchoice # Event notification


endif
```

## cansat_apps/lora_receiver/Kconfig
```kconfig
config CANSAT_APPS_LORA_RECEIVER
	tristate "LoRa receiver test app"
	default y
	---help---
		Enable the lora_receiver app

if CANSAT_APPS_LORA_RECEIVER

config CANSAT_APPS_LORA_RECEIVER_PROGNAME
	string "Program name"
	default "lora_receiver"
	---help---
		This is the name of the program that will be use when the NSH ELF
		program is installed.

config CANSAT_APPS_LORA_RECEIVER_PRIORITY
	int "lora_receiver task priority"
	default 100

config CANSAT_APPS_LORA_RECEIVER_STACKSIZE
	int "lora_receiver stack size"
	default 2048

endif
```

## cansat_apps/lora_test/Kconfig
```kconfig
config CANSAT_APPS_LORA_TEST
	tristate "Test RFM95 character driver"
	default y
	---help---
		Enable the lora_test app

if CANSAT_APPS_LORA_TEST

config CANSAT_APPS_LORA_TEST_PROGNAME
	string "Program name"
	default "lora_test"
	---help---
		This is the name of the program that will be use when the NSH ELF
		program is installed.

config CANSAT_APPS_LORA_TEST_PRIORITY
	int "lora_test task priority"
	default 100

config CANSAT_APPS_LORA_TEST_STACKSIZE
	int "lora_test stack size"
	default 2048

endif
```

## cansat_apps/pwm_test/Kconfig
```kconfig
config CANSAT_APPS_PWM_TEST
	tristate "PWM test using device driver"
	default y
	---help---
		Enable the pwm_test app

if CANSAT_APPS_PWM_TEST

config CANSAT_APPS_PWM_TEST_PROGNAME
	string "Program name"
	default "pwm_test"
	---help---
		This is the name of the program that will be use when the NSH ELF
		program is installed.

config CANSAT_APPS_PWM_TEST_PRIORITY
	int "pwm_test task priority"
	default 100

config CANSAT_APPS_PWM_TEST_STACKSIZE
	int "pwm_test stack size"
	default 2048

config CANSAT_APPS_PWM_TEST_DUTYCYCLE
	int "PWM signal duty cycle in %"
	default 50

config CANSAT_APPS_PWM_TEST_FREQUENCY
	int "PWM signal frequency in Hz"
	default 100

config CANSAT_APPS_PWM_TEST_DURATION
	int "PWM signal duration in µs"
	default 5e6

config CANSAT_APPS_PWM_TEST_DEVPATH
	string "PWM driver device path"
	default "/dev/pwm0"

endif
```

## cansat_apps/rfm95_userspace/Kconfig
```kconfig
config CANSAT_APPS_RFM95_USERSPACE
	tristate "Userspace library for LoRa transmission via RFM95"
	default y
	---help---
		Enable the rfm95_userspace app

if CANSAT_APPS_RFM95_USERSPACE

config CANSAT_APPS_RFM95_USERSPACE_PROGNAME
	string "Program name"
	default "rfm95_userspace"
	---help---
		This is the name of the program that will be use when the NSH ELF
		program is installed.

config CANSAT_APPS_RFM95_USERSPACE_PRIORITY
	int "rfm95_userspace task priority"
	default 100

config CANSAT_APPS_RFM95_USERSPACE_STACKSIZE
	int "rfm95_userspace stack size"
	default 2048

endif
```
